## conf/distro/clik.conf
```bitbake
# inherit base settings coming from poky

include conf/distro/poky.conf

# define distro name
DISTRO = "clik"

DISTRO_NAME += "Clik@Polito Hackathon distribution"

DISTRO_VERSION = "2"

DISTRO_CODENAME = "clik"

MAINTAINER += "Francesco Giancane <francesco.giancane@polito.it>"

# alsa for audio support
DISTRO_FEATURES += "alsa"

# bluetooth support
DISTRO_FEATURES += "bluetooth bluez5"

# keymaps
DISTRO_FEATURES += "keyboard"

# systemd init system
DISTRO_FEATURES += "systemd"
DISTRO_FEATURES_remove = "sysvinit"

# enable usb host support
DISTRO_FEATURES += "usbhost"

# networking via WiFi
DISTRO_FEATURES += "wifi"

# avahi & zeroconf
DISTRO_FEATURES += "avahi zeroconf"

DISTRO_FEATURES += "dri glx"

# select systemd as init manager
VIRTUAL-RUNTIME_init_manager = "systemd"

# remove extra data from systemv
#DISTRO_FEATURES_BACKFULL_CONSIDERED = "sysvinit"
VIRTUAL-RUNTIME_initscripts = ""
```
